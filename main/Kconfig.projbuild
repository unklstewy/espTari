## main/Kconfig.projbuild
```kconfig
menu "espTari Configuration"

    menu "Unified EBIN Composition"

        config ESPTARI_UNIFIED_EBIN_ENABLE
            bool "Enable unified-EBIN boot profile resolver"
            default n
            help
                Enables menuconfig-driven unified machine profile selection.
                This is the migration path toward unified composition while
                preserving atomic EBIN component compatibility.

        config ESPTARI_UNIFIED_ALLOW_RUNTIME_PROFILE_OVERRIDE
            bool "Allow runtime profile override from API/UI"
            default y
            depends on ESPTARI_UNIFIED_EBIN_ENABLE
            help
                When enabled, API/UI profile selection can override the
                menuconfig-selected unified profile.

        choice ESPTARI_UNIFIED_BASE_PROFILE
            prompt "Unified base profile"
            default ESPTARI_UNIFIED_PROFILE_MEGA_STE_16MB
            depends on ESPTARI_UNIFIED_EBIN_ENABLE
            help
                Selects the canonical baseline profile used by unified mode.
                The initial implementation focuses on Mega STe (16MB target).

            config ESPTARI_UNIFIED_PROFILE_ST
                bool "Atari ST baseline"

            config ESPTARI_UNIFIED_PROFILE_STFM
                bool "Atari STFM baseline"

            config ESPTARI_UNIFIED_PROFILE_STE
                bool "Atari STe baseline"

            config ESPTARI_UNIFIED_PROFILE_MEGA_ST
                bool "Atari Mega ST baseline"

            config ESPTARI_UNIFIED_PROFILE_MEGA_STE_16MB
                bool "Atari Mega STe baseline (16MB target)"

            config ESPTARI_UNIFIED_PROFILE_MEGA_STE_MONOLITH
                bool "Atari Mega STe monolithic EBIN prototype"

        endchoice

        menu "Unified module capability matrix"
            depends on ESPTARI_UNIFIED_EBIN_ENABLE

            config ESPTARI_UNIFIED_MODULE_CPU_M68000
                bool "CPU module: MC68000"
                default y
                help
                    Required for all currently supported ST-family profiles.

            config ESPTARI_UNIFIED_MODULE_VIDEO_SHIFTER
                bool "Video module: ST Shifter"
                default y

            config ESPTARI_UNIFIED_MODULE_VIDEO_STE_SHIFTER
                bool "Video module: STe Enhanced Shifter"
                default y

            config ESPTARI_UNIFIED_MODULE_AUDIO_YM2149
                bool "Audio module: YM2149 PSG"
                default y

            config ESPTARI_UNIFIED_MODULE_AUDIO_DMA
                bool "Audio module: DMA audio"
                default y

            config ESPTARI_UNIFIED_MODULE_IO_MFP68901
                bool "I/O module: MFP 68901"
                default y

            config ESPTARI_UNIFIED_MODULE_IO_FDC_WD1772
                bool "I/O module: WD1772 FDC"
                default y

            config ESPTARI_UNIFIED_MODULE_IO_BLITTER
                bool "I/O module: Blitter"
                default y
        endmenu

    endmenu

    config ESPTARI_DEFAULT_MACHINE
        string "Default machine profile"
        default "st"
        help
            Name of the default machine profile to load on boot.
            Must match a JSON file in /sdcard/machines/ (without .json extension).

    config ESPTARI_WEB_PORT
        int "Web server HTTP port"
        default 80
        help
            Port number for the espTari web interface.

    config ESPTARI_STREAM_PORT
        int "Streaming WebSocket port"
        default 8080
        help
            Port number for the A/V streaming WebSocket endpoint.

    config ESPTARI_AUTO_START
        bool "Auto-start emulation on boot"
        default n
        help
            If enabled, the emulator will automatically start the default
            machine profile after initialization. Otherwise, start via
            the web interface.

endmenu
```

## test_apps/esptari_loader/sdkconfig.defaults
```kconfig
# espTari Loader Test App
CONFIG_IDF_TARGET="esp32p4"

# Enable PSRAM
CONFIG_SPIRAM=y
CONFIG_SPIRAM_ALLOW_STACK_EXTERNAL_MEMORY=y

# Unity test framework
CONFIG_UNITY_ENABLE_FIXTURE=y
CONFIG_UNITY_ENABLE_IDF_TEST_RUNNER=y

# Logging
CONFIG_LOG_DEFAULT_LEVEL_INFO=y
```

## test_apps/esptari_loader_integration/sdkconfig.defaults
```kconfig
# espTari Loader Integration Test Configuration

# Target: ESP32-P4
CONFIG_IDF_TARGET="esp32p4"

# Use custom partition table
CONFIG_PARTITION_TABLE_CUSTOM=y
CONFIG_PARTITION_TABLE_CUSTOM_FILENAME="partitions.csv"

# PSRAM configuration
CONFIG_SPIRAM=y
CONFIG_SPIRAM_MODE_HEX=y
CONFIG_SPIRAM_SPEED_20M=y

# Enable XIP from PSRAM - allows code execution from PSRAM
CONFIG_SPIRAM_XIP_FROM_PSRAM=y

# Disable PMP IDRAM split to allow code execution from dynamically allocated memory
# Required for dynamic code loading (esptari loader)
CONFIG_ESP_SYSTEM_PMP_IDRAM_SPLIT=n

# Flash size
CONFIG_ESPTOOLPY_FLASHSIZE_16MB=y

# SPIFFS configuration  
CONFIG_SPIFFS_MAX_PARTITIONS=3

# Logging
CONFIG_LOG_DEFAULT_LEVEL_INFO=y
```

## test_apps/network_test/main/Kconfig.projbuild
```kconfig
menu "espTari Network Test Configuration"

    config ESPTARI_TEST_WIFI_SSID
        string "WiFi SSID"
        default "myssid"
        help
            SSID of the WiFi network to connect to.

    config ESPTARI_TEST_WIFI_PASSWORD
        string "WiFi Password"
        default "mypassword"
        help
            Password for the WiFi network.

    config ESPTARI_TEST_CONNECT_TIMEOUT_S
        int "Connection timeout (seconds)"
        default 30
        help
            Maximum time to wait for network connectivity.

endmenu
```

## test_apps/network_test/sdkconfig.defaults
```kconfig
# espTari Network Test - SDK Configuration Defaults
# Target: ESP32-P4-NANO

# Target chip
CONFIG_IDF_TARGET="esp32p4"

# Partition table (use espTari's main partition table)
CONFIG_PARTITION_TABLE_CUSTOM=y
CONFIG_PARTITION_TABLE_CUSTOM_FILENAME="../../partitions.csv"
CONFIG_PARTITION_TABLE_FILENAME="../../partitions.csv"

# Flash size (16MB)
CONFIG_ESPTOOLPY_FLASHSIZE_16MB=y
CONFIG_ESPTOOLPY_FLASHSIZE="16MB"

# PSRAM (32MB)
CONFIG_SPIRAM=y
CONFIG_SPIRAM_MODE_OCT=y
CONFIG_SPIRAM_SPEED_80M=y
CONFIG_SPIRAM_BOOT_INIT=y
CONFIG_SPIRAM_USE_CAPS_ALLOC=y

# CPU frequency
CONFIG_ESP_DEFAULT_CPU_FREQ_MHZ_400=y
CONFIG_ESP_DEFAULT_CPU_FREQ_MHZ=400

# FreeRTOS
CONFIG_FREERTOS_HZ=1000

# Main task needs extra stack for YAML serialization + logging
CONFIG_ESP_MAIN_TASK_STACK_SIZE=8192

# Log level
CONFIG_LOG_DEFAULT_LEVEL_INFO=y
CONFIG_LOG_DEFAULT_LEVEL=3

# SPIFFS
CONFIG_SPIFFS_MAX_PARTITIONS=1

# Ethernet (internal EMAC + IP101 PHY)
CONFIG_ETH_ENABLED=y
CONFIG_ETH_USE_ESP32_EMAC=y

# WiFi — disable SoftAP support (STA only)
CONFIG_ESP_WIFI_SOFTAP_SUPPORT=n

# Optimization
CONFIG_COMPILER_OPTIMIZATION_PERF=y

# Watchdog — generous for network init
CONFIG_ESP_TASK_WDT_TIMEOUT_S=15

# lwIP — needed for mDNS and networking
CONFIG_LWIP_IPV6=n
```

## test_apps/st_hardware_test/sdkconfig.defaults
```kconfig
# Target: ESP32-P4
CONFIG_IDF_TARGET="esp32p4"

# PSRAM support
CONFIG_SPIRAM=y
CONFIG_SPIRAM_MODE_HEX=y
CONFIG_SPIRAM_SPEED_200M=y
CONFIG_SPIRAM_XIP_FROM_PSRAM=y

# Disable PMP IDRAM split to allow executable memory allocation
CONFIG_ESP_SYSTEM_PMP_IDRAM_SPLIT=n

# SD/MMC configuration
CONFIG_SOC_SDMMC_USE_GPIO_MATRIX=y

# FAT filesystem
CONFIG_FATFS_VFS_FSTAT_BLKSIZE=4096
CONFIG_FATFS_LFN_HEAP=y
CONFIG_FATFS_MAX_LFN=255

# Logging
CONFIG_LOG_DEFAULT_LEVEL_INFO=y
```
