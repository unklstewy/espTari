## sdkconfig.defaults
```kconfig
# espTari SDK Configuration Defaults
# Target: ESP32-P4

# Target chip
CONFIG_IDF_TARGET="esp32p4"

# Partition table
CONFIG_PARTITION_TABLE_CUSTOM=y
CONFIG_PARTITION_TABLE_CUSTOM_FILENAME="partitions.csv"
CONFIG_PARTITION_TABLE_FILENAME="partitions.csv"

# Flash size (16MB)
CONFIG_ESPTOOLPY_FLASHSIZE_16MB=y
CONFIG_ESPTOOLPY_FLASHSIZE="16MB"

# PSRAM (32MB @ 20MHz — 200MHz requires IDF_EXPERIMENTAL_FEATURES)
CONFIG_SPIRAM=y
CONFIG_SPIRAM_MODE_HEX=y
CONFIG_SPIRAM_SPEED_20M=y
CONFIG_SPIRAM_BOOT_INIT=y
CONFIG_SPIRAM_USE_CAPS_ALLOC=y

# L2 Cache (256KB, 64-byte line)
CONFIG_CACHE_L2_CACHE_256KB=y
CONFIG_CACHE_L2_CACHE_LINE_64B=y

# CPU frequency
CONFIG_ESP_DEFAULT_CPU_FREQ_MHZ_400=y
CONFIG_ESP_DEFAULT_CPU_FREQ_MHZ=400

# Heap
CONFIG_HEAP_POISONING_LIGHT=y
CONFIG_ESP_SYSTEM_PMP_IDRAM_SPLIT=n

# FreeRTOS
CONFIG_FREERTOS_HZ=1000
CONFIG_FREERTOS_TIMER_TASK_STACK_DEPTH=3072

# Log level
CONFIG_LOG_DEFAULT_LEVEL_INFO=y
CONFIG_LOG_DEFAULT_LEVEL=3

# SPIFFS
CONFIG_SPIFFS_MAX_PARTITIONS=1

# FAT filesystem
CONFIG_FATFS_LFN_HEAP=y
CONFIG_FATFS_MAX_LFN=255

# SD card
CONFIG_SOC_SDMMC_USE_GPIO_MATRIX=y

# Ethernet (internal EMAC + IP101 PHY)
CONFIG_ETH_ENABLED=y
CONFIG_ETH_USE_ESP32_EMAC=y

# WiFi (via ESP32-C6 co-processor)
CONFIG_ESP_WIFI_SOFTAP_SUPPORT=n
CONFIG_ESP_HOSTED_ENABLED=y
CONFIG_ESP_WIFI_REMOTE_ENABLED=y
CONFIG_ESP_WIFI_REMOTE_LIBRARY_HOSTED=y
CONFIG_ESP_HOSTED_P4_DEV_BOARD_NONE=y
CONFIG_ESP_HOSTED_SDIO_HOST_INTERFACE=y
CONFIG_ESP_HOSTED_IDF_SLAVE_TARGET="esp32c6"
CONFIG_ESP_HOSTED_SDIO_SLOT_1=y
CONFIG_ESP_HOSTED_SDIO_4_BIT_BUS=y
CONFIG_ESP_HOSTED_SDIO_CLOCK_FREQ_KHZ=40000
CONFIG_ESP_HOSTED_PRIV_SDIO_PIN_CMD_SLOT_1=19
CONFIG_ESP_HOSTED_PRIV_SDIO_PIN_CLK_SLOT_1=18
CONFIG_ESP_HOSTED_PRIV_SDIO_PIN_D0_SLOT_1=14
CONFIG_ESP_HOSTED_PRIV_SDIO_PIN_D1_4BIT_BUS_SLOT_1=15
CONFIG_ESP_HOSTED_PRIV_SDIO_PIN_D2_4BIT_BUS_SLOT_1=16
CONFIG_ESP_HOSTED_PRIV_SDIO_PIN_D3_4BIT_BUS_SLOT_1=17
CONFIG_ESP_HOSTED_SDIO_GPIO_RESET_SLAVE=54
CONFIG_ESP_HOSTED_GPIO_SLAVE_RESET_SLAVE=54
CONFIG_ESP_HOSTED_SLAVE_RESET_ON_EVERY_HOST_BOOTUP=y

# OTA
CONFIG_BOOTLOADER_APP_ROLLBACK_ENABLE=y

# Watchdog
CONFIG_ESP_TASK_WDT_TIMEOUT_S=10

# Optimization
CONFIG_COMPILER_OPTIMIZATION_PERF=y

# HTTP server — WebSocket support for A/V streaming
CONFIG_HTTPD_WS_SUPPORT=y

# API Authentication
CONFIG_ESPTARI_API_AUTH_MODE_TOKEN=y
CONFIG_ESPTARI_API_TOKEN_CLIENT_ID="esptari-smoke"
CONFIG_ESPTARI_API_TOKEN_CLIENT_SECRET="esptari-smoke-secret"
CONFIG_ESPTARI_API_TOKEN_DEFAULT_SCOPE="ebin:manage"
CONFIG_ESPTARI_API_TOKEN_TTL_SECONDS=3600

# Unified EBIN Composition (Phase A baseline)
CONFIG_ESPTARI_UNIFIED_EBIN_ENABLE=y
CONFIG_ESPTARI_UNIFIED_ALLOW_RUNTIME_PROFILE_OVERRIDE=n
CONFIG_ESPTARI_UNIFIED_PROFILE_MEGA_STE_MONOLITH=y
CONFIG_ESPTARI_UNIFIED_MODULE_CPU_M68000=y
CONFIG_ESPTARI_UNIFIED_MODULE_VIDEO_SHIFTER=y
CONFIG_ESPTARI_UNIFIED_MODULE_VIDEO_STE_SHIFTER=y
CONFIG_ESPTARI_UNIFIED_MODULE_AUDIO_YM2149=y
CONFIG_ESPTARI_UNIFIED_MODULE_AUDIO_DMA=y
CONFIG_ESPTARI_UNIFIED_MODULE_IO_MFP68901=y
CONFIG_ESPTARI_UNIFIED_MODULE_IO_FDC_WD1772=y
CONFIG_ESPTARI_UNIFIED_MODULE_IO_BLITTER=y
```
